# file: FLASH.ioc
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Mcu.Family=STM32F1
Mcu.Name=STM32F103C(8-B)Tx
Mcu.Package=LQFP48
NVIC.PriorityGroup=NVIC_PRIORITYGROUP_4
PA13.Mode=Serial_Wire
PA13.Signal=SYS_JTMS-SWDIO
PA14.Mode=Serial_Wire
PA14.Signal=SYS_JTCK-SWCLK
ProjectManager.HeapSize=0x200
ProjectManager.StackSize=0x400
ProjectManager.TargetToolchain=MDK-ARM V5.32
RCC.AHBFreq_Value=8000000
RCC.APB1CLKDivider=RCC_HCLK_DIV2
RCC.APB1Freq_Value=4000000
RCC.APB1TimFreq_Value=8000000
RCC.APB2Freq_Value=8000000
RCC.APB2TimFreq_Value=8000000
RCC.HCLKFreq_Value=8000000
RCC.PLLMUL=RCC_PLL_MUL9
RCC.SYSCLKFreq_VALUE=8000000
RCC.USBFreq_Value=36000000
board=custom

// file: Core/Src/main.c
/* USER CODE BEGIN Header */
/**
  ******************************************************************************
  * @file           : main.c
  * @brief          : Main program body
  ******************************************************************************
  * @attention
  *
  * Copyright (c) 2024 STMicroelectronics.
  * All rights reserved.
  *
  * This software is licensed under terms that can be found in the LICENSE file
  * in the root directory of this software component.
  * If no LICENSE file comes with this software, it is provided AS-IS.
  *
  ******************************************************************************
  */
/* USER CODE END Header */
#include "main.h"

/* USER CODE BEGIN Includes */
#define FLASH_ADDR_PAGE_126 ((uint32_t)0x0801F810)	//Page 126
#define FLASH_ADDR_PAGE_127 ((uint32_t)0x0801FC00)	//Page 127

#define FLASH_USER_START_ADDR   FLASH_ADDR_PAGE_126
#define FLASH_USER_END_ADDR     FLASH_ADDR_PAGE_127 + FLASH_PAGE_SIZE
#define FLASH_ACR 0x00
#define FLASH_KEYR 0x04
#define FLASH_OPTKEYR 0x08
#define FLASH_SR 0x0C
#define FLASH_CR 0x10
#define FLASH_OPTCR 0x14
#define ADD ((uint32_t)0x0801FC01)
void Bumm_Flash();
uint32_t Address_Perius = 0;
uint32_t Data_1 = 0;
 uint32_t New_Address;
 struct {
	   volatile uint32_t Flash_New_Address;
	   volatile uint32_t Flash_This_Data;
	}C_EEPROM;
void FLASH_WritePage(uint32_t startPage, uint32_t endPage, uint32_t data);
uint32_t FLASH_ReadData(uint32_t addr);
/* USER CODE END Includes */

/* USER CODE BEGIN PM */
void Write_flash(uint32_t address, uint32_t data);
void Flash_earse(uint32_t address);
/* USER CODE END PM */

void SystemClock_Config(void);
static void MX_GPIO_Init(void);
/* USER CODE BEGIN PFP */
void Write_Data_to_Flash(uint32_t Address,uint32_t data);
/* USER CODE END PFP */

/* USER CODE BEGIN 0 */
uint8_t check = 0;
/* USER CODE END 0 */

int main(void)
{

  /* MCU Configuration--------------------------------------------------------*/

  /* Reset of all peripherals, Initializes the Flash interface and the Systick. */
  HAL_Init();

  /* Configure the system clock */
  SystemClock_Config();

  /* Initialize all configured peripherals */
  MX_GPIO_Init();
  /* USER CODE BEGIN 2 */
   FLASH_WritePage(FLASH_USER_START_ADDR,FLASH_USER_END_ADDR,0x5456);
//	 Write_Data_to_Flash(0x0801F820,0x2345);
  /* USER CODE END 2 */

  /* Infinite loop */
  while (1)
  {

  }
}

void SystemClock_Config(void)
{
  RCC_OscInitTypeDef RCC_OscInitStruct = {0};
  RCC_ClkInitTypeDef RCC_ClkInitStruct = {0};

  /** Initializes the RCC Oscillators according to the specified parameters
  * in the RCC_OscInitTypeDef structure.
  */
  RCC_OscInitStruct.OscillatorType = RCC_OSCILLATORTYPE_HSI;
  RCC_OscInitStruct.HSIState = RCC_HSI_ON;
  RCC_OscInitStruct.HSICalibrationValue = RCC_HSICALIBRATION_DEFAULT;
  RCC_OscInitStruct.PLL.PLLState = RCC_PLL_NONE;
  if (HAL_RCC_OscConfig(&RCC_OscInitStruct) != HAL_OK)
  {
    Error_Handler();
  }

  /** Initializes the CPU, AHB and APB buses clocks
  */
  RCC_ClkInitStruct.ClockType = RCC_CLOCKTYPE_HCLK|RCC_CLOCKTYPE_SYSCLK
                              |RCC_CLOCKTYPE_PCLK1|RCC_CLOCKTYPE_PCLK2;
  RCC_ClkInitStruct.SYSCLKSource = RCC_SYSCLKSOURCE_HSI;
  RCC_ClkInitStruct.AHBCLKDivider = RCC_SYSCLK_DIV1;
  RCC_ClkInitStruct.APB1CLKDivider = RCC_HCLK_DIV2;
  RCC_ClkInitStruct.APB2CLKDivider = RCC_HCLK_DIV1;

  if (HAL_RCC_ClockConfig(&RCC_ClkInitStruct, FLASH_LATENCY_0) != HAL_OK)
  {
    Error_Handler();
  }
}

static void MX_GPIO_Init(void)
{

  /* GPIO Ports Clock Enable */
  __HAL_RCC_GPIOA_CLK_ENABLE();

}

/* USER CODE BEGIN 4 */
//void Flash_earse(uint32_t address) {
//	HAL_FLASH_Unlock();
//	FLASH_EraseInitTypeDef flash;
//	flash.Banks = 1;
//	flash.NbPages = 1;
//	flash.PageAddress = address;
//	flash.TypeErase = FLASH_TYPEERASE_PAGES;
//	uint32_t pages;
//	HAL_FLASHEx_Erase(&flash,&pages);
//	HAL_FLASH_Lock();
//}

//void Write_flash(uint32_t address, uint32_t data) {
//	HAL_FLASH_Unlock();
//	HAL_FLASH_Program(FLASH_TYPEPROGRAM_HALFWORD,address,data);
//	HAL_FLASH_Lock();
//}

void FLASH_WritePage(uint32_t startPage, uint32_t endPage, uint32_t data)
{

  HAL_FLASH_Unlock();
	FLASH_EraseInitTypeDef EraseInit;
	EraseInit.TypeErase = FLASH_TYPEERASE_PAGES;
	EraseInit.PageAddress = startPage;
	EraseInit.NbPages = (endPage - startPage)/FLASH_PAGE_SIZE;
	uint32_t PageError = 0;
  Bumm_Flash();
	if(C_EEPROM.Flash_This_Data != 0xFFFFFFFF && C_EEPROM.Flash_New_Address < FLASH_ADDR_PAGE_127){
	   HAL_FLASHEx_Erase(&EraseInit, &PageError);
	}
	HAL_FLASH_Program(FLASH_TYPEPROGRAM_WORD, C_EEPROM.Flash_New_Address, data);
  HAL_FLASH_Lock();
}
uint32_t FLASH_ReadData(uint32_t addr)
{
	uint32_t data = *(__IO uint32_t *)(addr);
	return data;
}

void Bumm_Flash() {
	   for(uint32_t i = FLASH_ADDR_PAGE_126; i < FLASH_ADDR_PAGE_127; i+=4) {
			  C_EEPROM.Flash_This_Data = FLASH_ReadData(i);
			  if( C_EEPROM.Flash_This_Data  == 0xFFFFFFFF) {
					 C_EEPROM.Flash_New_Address = i;
					 break;
					}
			 }
}

void Write_Data_to_Flash(uint32_t Address,uint32_t data) {
	 if((FLASH->CR &(1 << 7)) !=0) {   // check key and unlock. 1 LOCK, 0 UNLOCK
		  FLASH->KEYR = 0x45670123;
		  FLASH->KEYR = 0xCDEF89AB;
		 check = 1;
		 }
	 	while((FLASH->SR & (1 << 0)) == 1);  // flag busy  : 1 = busy 0 = not busy
		check = 3;
	    FLASH->CR |= (1 << 0); // write data
		  *(uint32_t*)Address = data;
		 check = 4;
	//	 while((FLASH->SR & (1<<0)) == 1); // flag busy  : 1 = busy 0 = not busy
		  check = 6;
		  FLASH->CR &= (0 << 0);
			 check = 7;
		  FLASH->CR &= (0 << 7);

	  }
/* USER CODE END 4 */

void Error_Handler(void)
{
  __disable_irq();
  while (1)
  {
  }
}
